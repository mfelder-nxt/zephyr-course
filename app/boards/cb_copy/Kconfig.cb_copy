## app/boards/cb_copy/Kconfig.cb_copy
```kconfig
# Copyright (c) 2025 STMicroelectronics
# SPDX-License-Identifier: Apache-2.0

config BOARD_CB_COPY
	select SOC_STM32U385XX
```

## app/boards/cb_copy/board.yml
```yaml
board:
  name: cb_copy
  full_name: Custom Board copy from Nucleo U385RG Q
  vendor: st
  socs:
    - name: stm32u385xx
```

## app/boards/cb_scratch/board.yml
```yaml
board:
  name: cb_scratch
  full_name: Custom Board from scratch
  vendor: mfelder
  socs:
    - name: stm32u385xx
```

## dts/bindings/driver/our,driver.yaml
```yaml
description: Home Task 1 Driver
compatible: our,driver
include: base.yaml

properties:
  led:
    type: phandle
    required: true
    description: GPIO for the LED controlled by this driver
```
